## buildroot-external-tether/package/tether-os/Config.in
```kconfig
config BR2_PACKAGE_TETHER_OS
    bool "tether-os"
    depends on BR2_PACKAGE_PYTHON3
    help
        Tether OS shell and Tor rotation engine.
```
